#ifndef INCLUDED_CYFITTERIAR_INC
#define INCLUDED_CYFITTERIAR_INC
    INCLUDE cydeviceiar_trm.inc

/* led */
led__0__DM__MASK EQU 0x1C0
led__0__DM__SHIFT EQU 6
led__0__DR EQU CYREG_PRT1_DR
led__0__HSIOM EQU CYREG_HSIOM_PORT_SEL1
led__0__HSIOM_MASK EQU 0x00000F00
led__0__HSIOM_SHIFT EQU 8
led__0__INTCFG EQU CYREG_PRT1_INTCFG
led__0__INTSTAT EQU CYREG_PRT1_INTSTAT
led__0__MASK EQU 0x04
led__0__OUT_SEL EQU CYREG_UDB_PA1_CFG10
led__0__OUT_SEL_SHIFT EQU 4
led__0__OUT_SEL_VAL EQU 2
led__0__PA__CFG0 EQU CYREG_UDB_PA1_CFG0
led__0__PA__CFG1 EQU CYREG_UDB_PA1_CFG1
led__0__PA__CFG10 EQU CYREG_UDB_PA1_CFG10
led__0__PA__CFG11 EQU CYREG_UDB_PA1_CFG11
led__0__PA__CFG12 EQU CYREG_UDB_PA1_CFG12
led__0__PA__CFG13 EQU CYREG_UDB_PA1_CFG13
led__0__PA__CFG14 EQU CYREG_UDB_PA1_CFG14
led__0__PA__CFG2 EQU CYREG_UDB_PA1_CFG2
led__0__PA__CFG3 EQU CYREG_UDB_PA1_CFG3
led__0__PA__CFG4 EQU CYREG_UDB_PA1_CFG4
led__0__PA__CFG5 EQU CYREG_UDB_PA1_CFG5
led__0__PA__CFG6 EQU CYREG_UDB_PA1_CFG6
led__0__PA__CFG7 EQU CYREG_UDB_PA1_CFG7
led__0__PA__CFG8 EQU CYREG_UDB_PA1_CFG8
led__0__PA__CFG9 EQU CYREG_UDB_PA1_CFG9
led__0__PC EQU CYREG_PRT1_PC
led__0__PC2 EQU CYREG_PRT1_PC2
led__0__PORT EQU 1
led__0__PS EQU CYREG_PRT1_PS
led__0__SHIFT EQU 2
led__DR EQU CYREG_PRT1_DR
led__INTCFG EQU CYREG_PRT1_INTCFG
led__INTSTAT EQU CYREG_PRT1_INTSTAT
led__MASK EQU 0x04
led__PA__CFG0 EQU CYREG_UDB_PA1_CFG0
led__PA__CFG1 EQU CYREG_UDB_PA1_CFG1
led__PA__CFG10 EQU CYREG_UDB_PA1_CFG10
led__PA__CFG11 EQU CYREG_UDB_PA1_CFG11
led__PA__CFG12 EQU CYREG_UDB_PA1_CFG12
led__PA__CFG13 EQU CYREG_UDB_PA1_CFG13
led__PA__CFG14 EQU CYREG_UDB_PA1_CFG14
led__PA__CFG2 EQU CYREG_UDB_PA1_CFG2
led__PA__CFG3 EQU CYREG_UDB_PA1_CFG3
led__PA__CFG4 EQU CYREG_UDB_PA1_CFG4
led__PA__CFG5 EQU CYREG_UDB_PA1_CFG5
led__PA__CFG6 EQU CYREG_UDB_PA1_CFG6
led__PA__CFG7 EQU CYREG_UDB_PA1_CFG7
led__PA__CFG8 EQU CYREG_UDB_PA1_CFG8
led__PA__CFG9 EQU CYREG_UDB_PA1_CFG9
led__PC EQU CYREG_PRT1_PC
led__PC2 EQU CYREG_PRT1_PC2
led__PORT EQU 1
led__PS EQU CYREG_PRT1_PS
led__SHIFT EQU 2

/* MISO */
MISO__0__DM__MASK EQU 0x38000
MISO__0__DM__SHIFT EQU 15
MISO__0__DR EQU CYREG_PRT0_DR
MISO__0__HSIOM EQU CYREG_HSIOM_PORT_SEL0
MISO__0__HSIOM_MASK EQU 0x00F00000
MISO__0__HSIOM_SHIFT EQU 20
MISO__0__INTCFG EQU CYREG_PRT0_INTCFG
MISO__0__INTSTAT EQU CYREG_PRT0_INTSTAT
MISO__0__MASK EQU 0x20
MISO__0__PA__CFG0 EQU CYREG_UDB_PA0_CFG0
MISO__0__PA__CFG1 EQU CYREG_UDB_PA0_CFG1
MISO__0__PA__CFG10 EQU CYREG_UDB_PA0_CFG10
MISO__0__PA__CFG11 EQU CYREG_UDB_PA0_CFG11
MISO__0__PA__CFG12 EQU CYREG_UDB_PA0_CFG12
MISO__0__PA__CFG13 EQU CYREG_UDB_PA0_CFG13
MISO__0__PA__CFG14 EQU CYREG_UDB_PA0_CFG14
MISO__0__PA__CFG2 EQU CYREG_UDB_PA0_CFG2
MISO__0__PA__CFG3 EQU CYREG_UDB_PA0_CFG3
MISO__0__PA__CFG4 EQU CYREG_UDB_PA0_CFG4
MISO__0__PA__CFG5 EQU CYREG_UDB_PA0_CFG5
MISO__0__PA__CFG6 EQU CYREG_UDB_PA0_CFG6
MISO__0__PA__CFG7 EQU CYREG_UDB_PA0_CFG7
MISO__0__PA__CFG8 EQU CYREG_UDB_PA0_CFG8
MISO__0__PA__CFG9 EQU CYREG_UDB_PA0_CFG9
MISO__0__PC EQU CYREG_PRT0_PC
MISO__0__PC2 EQU CYREG_PRT0_PC2
MISO__0__PORT EQU 0
MISO__0__PS EQU CYREG_PRT0_PS
MISO__0__SHIFT EQU 5
MISO__DR EQU CYREG_PRT0_DR
MISO__INTCFG EQU CYREG_PRT0_INTCFG
MISO__INTSTAT EQU CYREG_PRT0_INTSTAT
MISO__MASK EQU 0x20
MISO__PA__CFG0 EQU CYREG_UDB_PA0_CFG0
MISO__PA__CFG1 EQU CYREG_UDB_PA0_CFG1
MISO__PA__CFG10 EQU CYREG_UDB_PA0_CFG10
MISO__PA__CFG11 EQU CYREG_UDB_PA0_CFG11
MISO__PA__CFG12 EQU CYREG_UDB_PA0_CFG12
MISO__PA__CFG13 EQU CYREG_UDB_PA0_CFG13
MISO__PA__CFG14 EQU CYREG_UDB_PA0_CFG14
MISO__PA__CFG2 EQU CYREG_UDB_PA0_CFG2
MISO__PA__CFG3 EQU CYREG_UDB_PA0_CFG3
MISO__PA__CFG4 EQU CYREG_UDB_PA0_CFG4
MISO__PA__CFG5 EQU CYREG_UDB_PA0_CFG5
MISO__PA__CFG6 EQU CYREG_UDB_PA0_CFG6
MISO__PA__CFG7 EQU CYREG_UDB_PA0_CFG7
MISO__PA__CFG8 EQU CYREG_UDB_PA0_CFG8
MISO__PA__CFG9 EQU CYREG_UDB_PA0_CFG9
MISO__PC EQU CYREG_PRT0_PC
MISO__PC2 EQU CYREG_PRT0_PC2
MISO__PORT EQU 0
MISO__PS EQU CYREG_PRT0_PS
MISO__SHIFT EQU 5

/* MOSI */
MOSI__0__DM__MASK EQU 0x7000
MOSI__0__DM__SHIFT EQU 12
MOSI__0__DR EQU CYREG_PRT0_DR
MOSI__0__HSIOM EQU CYREG_HSIOM_PORT_SEL0
MOSI__0__HSIOM_MASK EQU 0x000F0000
MOSI__0__HSIOM_SHIFT EQU 16
MOSI__0__INTCFG EQU CYREG_PRT0_INTCFG
MOSI__0__INTSTAT EQU CYREG_PRT0_INTSTAT
MOSI__0__MASK EQU 0x10
MOSI__0__OUT_SEL EQU CYREG_UDB_PA0_CFG10
MOSI__0__OUT_SEL_SHIFT EQU 8
MOSI__0__OUT_SEL_VAL EQU 1
MOSI__0__PA__CFG0 EQU CYREG_UDB_PA0_CFG0
MOSI__0__PA__CFG1 EQU CYREG_UDB_PA0_CFG1
MOSI__0__PA__CFG10 EQU CYREG_UDB_PA0_CFG10
MOSI__0__PA__CFG11 EQU CYREG_UDB_PA0_CFG11
MOSI__0__PA__CFG12 EQU CYREG_UDB_PA0_CFG12
MOSI__0__PA__CFG13 EQU CYREG_UDB_PA0_CFG13
MOSI__0__PA__CFG14 EQU CYREG_UDB_PA0_CFG14
MOSI__0__PA__CFG2 EQU CYREG_UDB_PA0_CFG2
MOSI__0__PA__CFG3 EQU CYREG_UDB_PA0_CFG3
MOSI__0__PA__CFG4 EQU CYREG_UDB_PA0_CFG4
MOSI__0__PA__CFG5 EQU CYREG_UDB_PA0_CFG5
MOSI__0__PA__CFG6 EQU CYREG_UDB_PA0_CFG6
MOSI__0__PA__CFG7 EQU CYREG_UDB_PA0_CFG7
MOSI__0__PA__CFG8 EQU CYREG_UDB_PA0_CFG8
MOSI__0__PA__CFG9 EQU CYREG_UDB_PA0_CFG9
MOSI__0__PC EQU CYREG_PRT0_PC
MOSI__0__PC2 EQU CYREG_PRT0_PC2
MOSI__0__PORT EQU 0
MOSI__0__PS EQU CYREG_PRT0_PS
MOSI__0__SHIFT EQU 4
MOSI__DR EQU CYREG_PRT0_DR
MOSI__INTCFG EQU CYREG_PRT0_INTCFG
MOSI__INTSTAT EQU CYREG_PRT0_INTSTAT
MOSI__MASK EQU 0x10
MOSI__PA__CFG0 EQU CYREG_UDB_PA0_CFG0
MOSI__PA__CFG1 EQU CYREG_UDB_PA0_CFG1
MOSI__PA__CFG10 EQU CYREG_UDB_PA0_CFG10
MOSI__PA__CFG11 EQU CYREG_UDB_PA0_CFG11
MOSI__PA__CFG12 EQU CYREG_UDB_PA0_CFG12
MOSI__PA__CFG13 EQU CYREG_UDB_PA0_CFG13
MOSI__PA__CFG14 EQU CYREG_UDB_PA0_CFG14
MOSI__PA__CFG2 EQU CYREG_UDB_PA0_CFG2
MOSI__PA__CFG3 EQU CYREG_UDB_PA0_CFG3
MOSI__PA__CFG4 EQU CYREG_UDB_PA0_CFG4
MOSI__PA__CFG5 EQU CYREG_UDB_PA0_CFG5
MOSI__PA__CFG6 EQU CYREG_UDB_PA0_CFG6
MOSI__PA__CFG7 EQU CYREG_UDB_PA0_CFG7
MOSI__PA__CFG8 EQU CYREG_UDB_PA0_CFG8
MOSI__PA__CFG9 EQU CYREG_UDB_PA0_CFG9
MOSI__PC EQU CYREG_PRT0_PC
MOSI__PC2 EQU CYREG_PRT0_PC2
MOSI__PORT EQU 0
MOSI__PS EQU CYREG_PRT0_PS
MOSI__SHIFT EQU 4

/* SCLK */
SCLK__0__DM__MASK EQU 0x1C0000
SCLK__0__DM__SHIFT EQU 18
SCLK__0__DR EQU CYREG_PRT0_DR
SCLK__0__HSIOM EQU CYREG_HSIOM_PORT_SEL0
SCLK__0__HSIOM_MASK EQU 0x0F000000
SCLK__0__HSIOM_SHIFT EQU 24
SCLK__0__INTCFG EQU CYREG_PRT0_INTCFG
SCLK__0__INTSTAT EQU CYREG_PRT0_INTSTAT
SCLK__0__MASK EQU 0x40
SCLK__0__OUT_SEL EQU CYREG_UDB_PA0_CFG10
SCLK__0__OUT_SEL_SHIFT EQU 12
SCLK__0__OUT_SEL_VAL EQU 0
SCLK__0__PA__CFG0 EQU CYREG_UDB_PA0_CFG0
SCLK__0__PA__CFG1 EQU CYREG_UDB_PA0_CFG1
SCLK__0__PA__CFG10 EQU CYREG_UDB_PA0_CFG10
SCLK__0__PA__CFG11 EQU CYREG_UDB_PA0_CFG11
SCLK__0__PA__CFG12 EQU CYREG_UDB_PA0_CFG12
SCLK__0__PA__CFG13 EQU CYREG_UDB_PA0_CFG13
SCLK__0__PA__CFG14 EQU CYREG_UDB_PA0_CFG14
SCLK__0__PA__CFG2 EQU CYREG_UDB_PA0_CFG2
SCLK__0__PA__CFG3 EQU CYREG_UDB_PA0_CFG3
SCLK__0__PA__CFG4 EQU CYREG_UDB_PA0_CFG4
SCLK__0__PA__CFG5 EQU CYREG_UDB_PA0_CFG5
SCLK__0__PA__CFG6 EQU CYREG_UDB_PA0_CFG6
SCLK__0__PA__CFG7 EQU CYREG_UDB_PA0_CFG7
SCLK__0__PA__CFG8 EQU CYREG_UDB_PA0_CFG8
SCLK__0__PA__CFG9 EQU CYREG_UDB_PA0_CFG9
SCLK__0__PC EQU CYREG_PRT0_PC
SCLK__0__PC2 EQU CYREG_PRT0_PC2
SCLK__0__PORT EQU 0
SCLK__0__PS EQU CYREG_PRT0_PS
SCLK__0__SHIFT EQU 6
SCLK__DR EQU CYREG_PRT0_DR
SCLK__INTCFG EQU CYREG_PRT0_INTCFG
SCLK__INTSTAT EQU CYREG_PRT0_INTSTAT
SCLK__MASK EQU 0x40
SCLK__PA__CFG0 EQU CYREG_UDB_PA0_CFG0
SCLK__PA__CFG1 EQU CYREG_UDB_PA0_CFG1
SCLK__PA__CFG10 EQU CYREG_UDB_PA0_CFG10
SCLK__PA__CFG11 EQU CYREG_UDB_PA0_CFG11
SCLK__PA__CFG12 EQU CYREG_UDB_PA0_CFG12
SCLK__PA__CFG13 EQU CYREG_UDB_PA0_CFG13
SCLK__PA__CFG14 EQU CYREG_UDB_PA0_CFG14
SCLK__PA__CFG2 EQU CYREG_UDB_PA0_CFG2
SCLK__PA__CFG3 EQU CYREG_UDB_PA0_CFG3
SCLK__PA__CFG4 EQU CYREG_UDB_PA0_CFG4
SCLK__PA__CFG5 EQU CYREG_UDB_PA0_CFG5
SCLK__PA__CFG6 EQU CYREG_UDB_PA0_CFG6
SCLK__PA__CFG7 EQU CYREG_UDB_PA0_CFG7
SCLK__PA__CFG8 EQU CYREG_UDB_PA0_CFG8
SCLK__PA__CFG9 EQU CYREG_UDB_PA0_CFG9
SCLK__PC EQU CYREG_PRT0_PC
SCLK__PC2 EQU CYREG_PRT0_PC2
SCLK__PORT EQU 0
SCLK__PS EQU CYREG_PRT0_PS
SCLK__SHIFT EQU 6

/* SPIM_BSPIM */
SPIM_BSPIM_BitCounter__16BIT_CONTROL_AUX_CTL_REG EQU CYREG_UDB_W16_ACTL_00
SPIM_BSPIM_BitCounter__16BIT_CONTROL_CONTROL_REG EQU CYREG_UDB_W16_CTL_00
SPIM_BSPIM_BitCounter__16BIT_CONTROL_COUNT_REG EQU CYREG_UDB_W16_CTL_00
SPIM_BSPIM_BitCounter__16BIT_COUNT_CONTROL_REG EQU CYREG_UDB_W16_CTL_00
SPIM_BSPIM_BitCounter__16BIT_COUNT_COUNT_REG EQU CYREG_UDB_W16_CTL_00
SPIM_BSPIM_BitCounter__16BIT_MASK_MASK_REG EQU CYREG_UDB_W16_MSK_00
SPIM_BSPIM_BitCounter__16BIT_MASK_PERIOD_REG EQU CYREG_UDB_W16_MSK_00
SPIM_BSPIM_BitCounter__16BIT_PERIOD_MASK_REG EQU CYREG_UDB_W16_MSK_00
SPIM_BSPIM_BitCounter__16BIT_PERIOD_PERIOD_REG EQU CYREG_UDB_W16_MSK_00
SPIM_BSPIM_BitCounter__32BIT_CONTROL_AUX_CTL_REG EQU CYREG_UDB_W32_ACTL_00
SPIM_BSPIM_BitCounter__32BIT_CONTROL_REG EQU CYREG_UDB_W32_CTL_00
SPIM_BSPIM_BitCounter__32BIT_COUNT_REG EQU CYREG_UDB_W32_CTL_00
SPIM_BSPIM_BitCounter__32BIT_PERIOD_REG EQU CYREG_UDB_W32_MSK_00
SPIM_BSPIM_BitCounter__CONTROL_AUX_CTL_REG EQU CYREG_UDB_W8_ACTL_00
SPIM_BSPIM_BitCounter__CONTROL_REG EQU CYREG_UDB_W8_CTL_00
SPIM_BSPIM_BitCounter__CONTROL_ST_REG EQU CYREG_UDB_CAT16_CTL_ST_00
SPIM_BSPIM_BitCounter__COUNT_REG EQU CYREG_UDB_W8_CTL_00
SPIM_BSPIM_BitCounter__COUNT_ST_REG EQU CYREG_UDB_CAT16_CTL_ST_00
SPIM_BSPIM_BitCounter__MASK_CTL_AUX_CTL_REG EQU CYREG_UDB_CAT16_ACTL_MSK_00
SPIM_BSPIM_BitCounter__PER_CTL_AUX_CTL_REG EQU CYREG_UDB_CAT16_ACTL_MSK_00
SPIM_BSPIM_BitCounter__PERIOD_REG EQU CYREG_UDB_W8_MSK_00
SPIM_BSPIM_BitCounter_ST__16BIT_STATUS_AUX_CTL_REG EQU CYREG_UDB_W16_ACTL_00
SPIM_BSPIM_BitCounter_ST__16BIT_STATUS_REG EQU CYREG_UDB_W16_ST_00
SPIM_BSPIM_BitCounter_ST__32BIT_MASK_REG EQU CYREG_UDB_W32_MSK_00
SPIM_BSPIM_BitCounter_ST__32BIT_STATUS_AUX_CTL_REG EQU CYREG_UDB_W32_ACTL_00
SPIM_BSPIM_BitCounter_ST__32BIT_STATUS_REG EQU CYREG_UDB_W32_ST_00
SPIM_BSPIM_BitCounter_ST__MASK_REG EQU CYREG_UDB_W8_MSK_00
SPIM_BSPIM_BitCounter_ST__MASK_ST_AUX_CTL_REG EQU CYREG_UDB_CAT16_ACTL_MSK_00
SPIM_BSPIM_BitCounter_ST__PER_ST_AUX_CTL_REG EQU CYREG_UDB_CAT16_ACTL_MSK_00
SPIM_BSPIM_BitCounter_ST__STATUS_AUX_CTL_REG EQU CYREG_UDB_W8_ACTL_00
SPIM_BSPIM_BitCounter_ST__STATUS_CNT_REG EQU CYREG_UDB_CAT16_CTL_ST_00
SPIM_BSPIM_BitCounter_ST__STATUS_CONTROL_REG EQU CYREG_UDB_CAT16_CTL_ST_00
SPIM_BSPIM_BitCounter_ST__STATUS_REG EQU CYREG_UDB_W8_ST_00
SPIM_BSPIM_RxStsReg__4__MASK EQU 0x10
SPIM_BSPIM_RxStsReg__4__POS EQU 4
SPIM_BSPIM_RxStsReg__5__MASK EQU 0x20
SPIM_BSPIM_RxStsReg__5__POS EQU 5
SPIM_BSPIM_RxStsReg__6__MASK EQU 0x40
SPIM_BSPIM_RxStsReg__6__POS EQU 6
SPIM_BSPIM_RxStsReg__MASK EQU 0x70
SPIM_BSPIM_RxStsReg__MASK_REG EQU CYREG_UDB_W8_MSK_03
SPIM_BSPIM_RxStsReg__STATUS_AUX_CTL_REG EQU CYREG_UDB_W8_ACTL_03
SPIM_BSPIM_RxStsReg__STATUS_REG EQU CYREG_UDB_W8_ST_03
SPIM_BSPIM_sR8_Dp_u0__16BIT_A0_REG EQU CYREG_UDB_W16_A0_00
SPIM_BSPIM_sR8_Dp_u0__16BIT_A1_REG EQU CYREG_UDB_W16_A1_00
SPIM_BSPIM_sR8_Dp_u0__16BIT_D0_REG EQU CYREG_UDB_W16_D0_00
SPIM_BSPIM_sR8_Dp_u0__16BIT_D1_REG EQU CYREG_UDB_W16_D1_00
SPIM_BSPIM_sR8_Dp_u0__16BIT_DP_AUX_CTL_REG EQU CYREG_UDB_W16_ACTL_00
SPIM_BSPIM_sR8_Dp_u0__16BIT_F0_REG EQU CYREG_UDB_W16_F0_00
SPIM_BSPIM_sR8_Dp_u0__16BIT_F1_REG EQU CYREG_UDB_W16_F1_00
SPIM_BSPIM_sR8_Dp_u0__32BIT_A0_REG EQU CYREG_UDB_W32_A0_00
SPIM_BSPIM_sR8_Dp_u0__32BIT_A1_REG EQU CYREG_UDB_W32_A1_00
SPIM_BSPIM_sR8_Dp_u0__32BIT_D0_REG EQU CYREG_UDB_W32_D0_00
SPIM_BSPIM_sR8_Dp_u0__32BIT_D1_REG EQU CYREG_UDB_W32_D1_00
SPIM_BSPIM_sR8_Dp_u0__32BIT_DP_AUX_CTL_REG EQU CYREG_UDB_W32_ACTL_00
SPIM_BSPIM_sR8_Dp_u0__32BIT_F0_REG EQU CYREG_UDB_W32_F0_00
SPIM_BSPIM_sR8_Dp_u0__32BIT_F1_REG EQU CYREG_UDB_W32_F1_00
SPIM_BSPIM_sR8_Dp_u0__A0_A1_REG EQU CYREG_UDB_CAT16_A_00
SPIM_BSPIM_sR8_Dp_u0__A0_REG EQU CYREG_UDB_W8_A0_00
SPIM_BSPIM_sR8_Dp_u0__A1_REG EQU CYREG_UDB_W8_A1_00
SPIM_BSPIM_sR8_Dp_u0__D0_D1_REG EQU CYREG_UDB_CAT16_D_00
SPIM_BSPIM_sR8_Dp_u0__D0_REG EQU CYREG_UDB_W8_D0_00
SPIM_BSPIM_sR8_Dp_u0__D1_REG EQU CYREG_UDB_W8_D1_00
SPIM_BSPIM_sR8_Dp_u0__DP_AUX_CTL_REG EQU CYREG_UDB_W8_ACTL_00
SPIM_BSPIM_sR8_Dp_u0__F0_F1_REG EQU CYREG_UDB_CAT16_F_00
SPIM_BSPIM_sR8_Dp_u0__F0_REG EQU CYREG_UDB_W8_F0_00
SPIM_BSPIM_sR8_Dp_u0__F1_REG EQU CYREG_UDB_W8_F1_00
SPIM_BSPIM_sR8_Dp_u0__MSK_DP_AUX_CTL_REG EQU CYREG_UDB_CAT16_ACTL_MSK_00
SPIM_BSPIM_sR8_Dp_u0__PER_DP_AUX_CTL_REG EQU CYREG_UDB_CAT16_ACTL_MSK_00
SPIM_BSPIM_TxStsReg__0__MASK EQU 0x01
SPIM_BSPIM_TxStsReg__0__POS EQU 0
SPIM_BSPIM_TxStsReg__1__MASK EQU 0x02
SPIM_BSPIM_TxStsReg__1__POS EQU 1
SPIM_BSPIM_TxStsReg__16BIT_STATUS_AUX_CTL_REG EQU CYREG_UDB_W16_ACTL_01
SPIM_BSPIM_TxStsReg__16BIT_STATUS_REG EQU CYREG_UDB_W16_ST_01
SPIM_BSPIM_TxStsReg__2__MASK EQU 0x04
SPIM_BSPIM_TxStsReg__2__POS EQU 2
SPIM_BSPIM_TxStsReg__3__MASK EQU 0x08
SPIM_BSPIM_TxStsReg__3__POS EQU 3
SPIM_BSPIM_TxStsReg__4__MASK EQU 0x10
SPIM_BSPIM_TxStsReg__4__POS EQU 4
SPIM_BSPIM_TxStsReg__MASK EQU 0x1F
SPIM_BSPIM_TxStsReg__MASK_REG EQU CYREG_UDB_W8_MSK_01
SPIM_BSPIM_TxStsReg__STATUS_AUX_CTL_REG EQU CYREG_UDB_W8_ACTL_01
SPIM_BSPIM_TxStsReg__STATUS_REG EQU CYREG_UDB_W8_ST_01

/* SPIM_IntClock */
SPIM_IntClock__DIVIDER_MASK EQU 0x0000FFFF
SPIM_IntClock__ENABLE EQU CYREG_CLK_DIVIDER_A00
SPIM_IntClock__ENABLE_MASK EQU 0x80000000
SPIM_IntClock__MASK EQU 0x80000000
SPIM_IntClock__REGISTER EQU CYREG_CLK_DIVIDER_A00

/* PWM_1_PWMUDB */
PWM_1_PWMUDB_genblk1_ctrlreg__16BIT_CONTROL_AUX_CTL_REG EQU CYREG_UDB_W16_ACTL_02
PWM_1_PWMUDB_genblk1_ctrlreg__16BIT_CONTROL_CONTROL_REG EQU CYREG_UDB_W16_CTL_02
PWM_1_PWMUDB_genblk1_ctrlreg__16BIT_CONTROL_COUNT_REG EQU CYREG_UDB_W16_CTL_02
PWM_1_PWMUDB_genblk1_ctrlreg__16BIT_COUNT_CONTROL_REG EQU CYREG_UDB_W16_CTL_02
PWM_1_PWMUDB_genblk1_ctrlreg__16BIT_COUNT_COUNT_REG EQU CYREG_UDB_W16_CTL_02
PWM_1_PWMUDB_genblk1_ctrlreg__16BIT_MASK_MASK_REG EQU CYREG_UDB_W16_MSK_02
PWM_1_PWMUDB_genblk1_ctrlreg__16BIT_MASK_PERIOD_REG EQU CYREG_UDB_W16_MSK_02
PWM_1_PWMUDB_genblk1_ctrlreg__16BIT_PERIOD_MASK_REG EQU CYREG_UDB_W16_MSK_02
PWM_1_PWMUDB_genblk1_ctrlreg__16BIT_PERIOD_PERIOD_REG EQU CYREG_UDB_W16_MSK_02
PWM_1_PWMUDB_genblk1_ctrlreg__7__MASK EQU 0x80
PWM_1_PWMUDB_genblk1_ctrlreg__7__POS EQU 7
PWM_1_PWMUDB_genblk1_ctrlreg__CONTROL_AUX_CTL_REG EQU CYREG_UDB_W8_ACTL_02
PWM_1_PWMUDB_genblk1_ctrlreg__CONTROL_REG EQU CYREG_UDB_W8_CTL_02
PWM_1_PWMUDB_genblk1_ctrlreg__CONTROL_ST_REG EQU CYREG_UDB_CAT16_CTL_ST_02
PWM_1_PWMUDB_genblk1_ctrlreg__COUNT_REG EQU CYREG_UDB_W8_CTL_02
PWM_1_PWMUDB_genblk1_ctrlreg__COUNT_ST_REG EQU CYREG_UDB_CAT16_CTL_ST_02
PWM_1_PWMUDB_genblk1_ctrlreg__MASK EQU 0x80
PWM_1_PWMUDB_genblk1_ctrlreg__MASK_CTL_AUX_CTL_REG EQU CYREG_UDB_CAT16_ACTL_MSK_02
PWM_1_PWMUDB_genblk1_ctrlreg__PER_CTL_AUX_CTL_REG EQU CYREG_UDB_CAT16_ACTL_MSK_02
PWM_1_PWMUDB_genblk1_ctrlreg__PERIOD_REG EQU CYREG_UDB_W8_MSK_02
PWM_1_PWMUDB_genblk8_stsreg__0__MASK EQU 0x01
PWM_1_PWMUDB_genblk8_stsreg__0__POS EQU 0
PWM_1_PWMUDB_genblk8_stsreg__1__MASK EQU 0x02
PWM_1_PWMUDB_genblk8_stsreg__1__POS EQU 1
PWM_1_PWMUDB_genblk8_stsreg__16BIT_STATUS_AUX_CTL_REG EQU CYREG_UDB_W16_ACTL_02
PWM_1_PWMUDB_genblk8_stsreg__16BIT_STATUS_REG EQU CYREG_UDB_W16_ST_02
PWM_1_PWMUDB_genblk8_stsreg__2__MASK EQU 0x04
PWM_1_PWMUDB_genblk8_stsreg__2__POS EQU 2
PWM_1_PWMUDB_genblk8_stsreg__3__MASK EQU 0x08
PWM_1_PWMUDB_genblk8_stsreg__3__POS EQU 3
PWM_1_PWMUDB_genblk8_stsreg__MASK EQU 0x0F
PWM_1_PWMUDB_genblk8_stsreg__MASK_REG EQU CYREG_UDB_W8_MSK_02
PWM_1_PWMUDB_genblk8_stsreg__MASK_ST_AUX_CTL_REG EQU CYREG_UDB_CAT16_ACTL_MSK_02
PWM_1_PWMUDB_genblk8_stsreg__PER_ST_AUX_CTL_REG EQU CYREG_UDB_CAT16_ACTL_MSK_02
PWM_1_PWMUDB_genblk8_stsreg__STATUS_AUX_CTL_REG EQU CYREG_UDB_W8_ACTL_02
PWM_1_PWMUDB_genblk8_stsreg__STATUS_CNT_REG EQU CYREG_UDB_CAT16_CTL_ST_02
PWM_1_PWMUDB_genblk8_stsreg__STATUS_CONTROL_REG EQU CYREG_UDB_CAT16_CTL_ST_02
PWM_1_PWMUDB_genblk8_stsreg__STATUS_REG EQU CYREG_UDB_W8_ST_02
PWM_1_PWMUDB_sP16_pwmdp_u0__16BIT_A0_REG EQU CYREG_UDB_W16_A0_02
PWM_1_PWMUDB_sP16_pwmdp_u0__16BIT_A1_REG EQU CYREG_UDB_W16_A1_02
PWM_1_PWMUDB_sP16_pwmdp_u0__16BIT_D0_REG EQU CYREG_UDB_W16_D0_02
PWM_1_PWMUDB_sP16_pwmdp_u0__16BIT_D1_REG EQU CYREG_UDB_W16_D1_02
PWM_1_PWMUDB_sP16_pwmdp_u0__16BIT_DP_AUX_CTL_REG EQU CYREG_UDB_W16_ACTL_02
PWM_1_PWMUDB_sP16_pwmdp_u0__16BIT_F0_REG EQU CYREG_UDB_W16_F0_02
PWM_1_PWMUDB_sP16_pwmdp_u0__16BIT_F1_REG EQU CYREG_UDB_W16_F1_02
PWM_1_PWMUDB_sP16_pwmdp_u0__A0_A1_REG EQU CYREG_UDB_CAT16_A_02
PWM_1_PWMUDB_sP16_pwmdp_u0__A0_REG EQU CYREG_UDB_W8_A0_02
PWM_1_PWMUDB_sP16_pwmdp_u0__A1_REG EQU CYREG_UDB_W8_A1_02
PWM_1_PWMUDB_sP16_pwmdp_u0__D0_D1_REG EQU CYREG_UDB_CAT16_D_02
PWM_1_PWMUDB_sP16_pwmdp_u0__D0_REG EQU CYREG_UDB_W8_D0_02
PWM_1_PWMUDB_sP16_pwmdp_u0__D1_REG EQU CYREG_UDB_W8_D1_02
PWM_1_PWMUDB_sP16_pwmdp_u0__DP_AUX_CTL_REG EQU CYREG_UDB_W8_ACTL_02
PWM_1_PWMUDB_sP16_pwmdp_u0__F0_F1_REG EQU CYREG_UDB_CAT16_F_02
PWM_1_PWMUDB_sP16_pwmdp_u0__F0_REG EQU CYREG_UDB_W8_F0_02
PWM_1_PWMUDB_sP16_pwmdp_u0__F1_REG EQU CYREG_UDB_W8_F1_02
PWM_1_PWMUDB_sP16_pwmdp_u0__MSK_DP_AUX_CTL_REG EQU CYREG_UDB_CAT16_ACTL_MSK_02
PWM_1_PWMUDB_sP16_pwmdp_u0__PER_DP_AUX_CTL_REG EQU CYREG_UDB_CAT16_ACTL_MSK_02
PWM_1_PWMUDB_sP16_pwmdp_u1__A0_A1_REG EQU CYREG_UDB_CAT16_A_03
PWM_1_PWMUDB_sP16_pwmdp_u1__A0_REG EQU CYREG_UDB_W8_A0_03
PWM_1_PWMUDB_sP16_pwmdp_u1__A1_REG EQU CYREG_UDB_W8_A1_03
PWM_1_PWMUDB_sP16_pwmdp_u1__D0_D1_REG EQU CYREG_UDB_CAT16_D_03
PWM_1_PWMUDB_sP16_pwmdp_u1__D0_REG EQU CYREG_UDB_W8_D0_03
PWM_1_PWMUDB_sP16_pwmdp_u1__D1_REG EQU CYREG_UDB_W8_D1_03
PWM_1_PWMUDB_sP16_pwmdp_u1__DP_AUX_CTL_REG EQU CYREG_UDB_W8_ACTL_03
PWM_1_PWMUDB_sP16_pwmdp_u1__F0_F1_REG EQU CYREG_UDB_CAT16_F_03
PWM_1_PWMUDB_sP16_pwmdp_u1__F0_REG EQU CYREG_UDB_W8_F0_03
PWM_1_PWMUDB_sP16_pwmdp_u1__F1_REG EQU CYREG_UDB_W8_F1_03

/* isr_1 */
isr_1__INTC_CLR_EN_REG EQU CYREG_CM0_ICER
isr_1__INTC_CLR_PD_REG EQU CYREG_CM0_ICPR
isr_1__INTC_MASK EQU 0x10000
isr_1__INTC_NUMBER EQU 16
isr_1__INTC_PRIOR_MASK EQU 0xC0
isr_1__INTC_PRIOR_NUM EQU 3
isr_1__INTC_PRIOR_REG EQU CYREG_CM0_IPR4
isr_1__INTC_SET_EN_REG EQU CYREG_CM0_ISER
isr_1__INTC_SET_PD_REG EQU CYREG_CM0_ISPR

/* servo */
servo__0__DM__MASK EQU 0x07
servo__0__DM__SHIFT EQU 0
servo__0__DR EQU CYREG_PRT1_DR
servo__0__HSIOM EQU CYREG_HSIOM_PORT_SEL1
servo__0__HSIOM_MASK EQU 0x0000000F
servo__0__HSIOM_SHIFT EQU 0
servo__0__INTCFG EQU CYREG_PRT1_INTCFG
servo__0__INTSTAT EQU CYREG_PRT1_INTSTAT
servo__0__MASK EQU 0x01
servo__0__OUT_SEL EQU CYREG_UDB_PA1_CFG10
servo__0__OUT_SEL_SHIFT EQU 0
servo__0__OUT_SEL_VAL EQU 0
servo__0__PA__CFG0 EQU CYREG_UDB_PA1_CFG0
servo__0__PA__CFG1 EQU CYREG_UDB_PA1_CFG1
servo__0__PA__CFG10 EQU CYREG_UDB_PA1_CFG10
servo__0__PA__CFG11 EQU CYREG_UDB_PA1_CFG11
servo__0__PA__CFG12 EQU CYREG_UDB_PA1_CFG12
servo__0__PA__CFG13 EQU CYREG_UDB_PA1_CFG13
servo__0__PA__CFG14 EQU CYREG_UDB_PA1_CFG14
servo__0__PA__CFG2 EQU CYREG_UDB_PA1_CFG2
servo__0__PA__CFG3 EQU CYREG_UDB_PA1_CFG3
servo__0__PA__CFG4 EQU CYREG_UDB_PA1_CFG4
servo__0__PA__CFG5 EQU CYREG_UDB_PA1_CFG5
servo__0__PA__CFG6 EQU CYREG_UDB_PA1_CFG6
servo__0__PA__CFG7 EQU CYREG_UDB_PA1_CFG7
servo__0__PA__CFG8 EQU CYREG_UDB_PA1_CFG8
servo__0__PA__CFG9 EQU CYREG_UDB_PA1_CFG9
servo__0__PC EQU CYREG_PRT1_PC
servo__0__PC2 EQU CYREG_PRT1_PC2
servo__0__PORT EQU 1
servo__0__PS EQU CYREG_PRT1_PS
servo__0__SHIFT EQU 0
servo__DR EQU CYREG_PRT1_DR
servo__INTCFG EQU CYREG_PRT1_INTCFG
servo__INTSTAT EQU CYREG_PRT1_INTSTAT
servo__MASK EQU 0x01
servo__PA__CFG0 EQU CYREG_UDB_PA1_CFG0
servo__PA__CFG1 EQU CYREG_UDB_PA1_CFG1
servo__PA__CFG10 EQU CYREG_UDB_PA1_CFG10
servo__PA__CFG11 EQU CYREG_UDB_PA1_CFG11
servo__PA__CFG12 EQU CYREG_UDB_PA1_CFG12
servo__PA__CFG13 EQU CYREG_UDB_PA1_CFG13
servo__PA__CFG14 EQU CYREG_UDB_PA1_CFG14
servo__PA__CFG2 EQU CYREG_UDB_PA1_CFG2
servo__PA__CFG3 EQU CYREG_UDB_PA1_CFG3
servo__PA__CFG4 EQU CYREG_UDB_PA1_CFG4
servo__PA__CFG5 EQU CYREG_UDB_PA1_CFG5
servo__PA__CFG6 EQU CYREG_UDB_PA1_CFG6
servo__PA__CFG7 EQU CYREG_UDB_PA1_CFG7
servo__PA__CFG8 EQU CYREG_UDB_PA1_CFG8
servo__PA__CFG9 EQU CYREG_UDB_PA1_CFG9
servo__PC EQU CYREG_PRT1_PC
servo__PC2 EQU CYREG_PRT1_PC2
servo__PORT EQU 1
servo__PS EQU CYREG_PRT1_PS
servo__SHIFT EQU 0

/* WIZ_SS */
WIZ_SS__0__DM__MASK EQU 0xE00
WIZ_SS__0__DM__SHIFT EQU 9
WIZ_SS__0__DR EQU CYREG_PRT0_DR
WIZ_SS__0__HSIOM EQU CYREG_HSIOM_PORT_SEL0
WIZ_SS__0__HSIOM_MASK EQU 0x0000F000
WIZ_SS__0__HSIOM_SHIFT EQU 12
WIZ_SS__0__INTCFG EQU CYREG_PRT0_INTCFG
WIZ_SS__0__INTSTAT EQU CYREG_PRT0_INTSTAT
WIZ_SS__0__MASK EQU 0x08
WIZ_SS__0__PA__CFG0 EQU CYREG_UDB_PA0_CFG0
WIZ_SS__0__PA__CFG1 EQU CYREG_UDB_PA0_CFG1
WIZ_SS__0__PA__CFG10 EQU CYREG_UDB_PA0_CFG10
WIZ_SS__0__PA__CFG11 EQU CYREG_UDB_PA0_CFG11
WIZ_SS__0__PA__CFG12 EQU CYREG_UDB_PA0_CFG12
WIZ_SS__0__PA__CFG13 EQU CYREG_UDB_PA0_CFG13
WIZ_SS__0__PA__CFG14 EQU CYREG_UDB_PA0_CFG14
WIZ_SS__0__PA__CFG2 EQU CYREG_UDB_PA0_CFG2
WIZ_SS__0__PA__CFG3 EQU CYREG_UDB_PA0_CFG3
WIZ_SS__0__PA__CFG4 EQU CYREG_UDB_PA0_CFG4
WIZ_SS__0__PA__CFG5 EQU CYREG_UDB_PA0_CFG5
WIZ_SS__0__PA__CFG6 EQU CYREG_UDB_PA0_CFG6
WIZ_SS__0__PA__CFG7 EQU CYREG_UDB_PA0_CFG7
WIZ_SS__0__PA__CFG8 EQU CYREG_UDB_PA0_CFG8
WIZ_SS__0__PA__CFG9 EQU CYREG_UDB_PA0_CFG9
WIZ_SS__0__PC EQU CYREG_PRT0_PC
WIZ_SS__0__PC2 EQU CYREG_PRT0_PC2
WIZ_SS__0__PORT EQU 0
WIZ_SS__0__PS EQU CYREG_PRT0_PS
WIZ_SS__0__SHIFT EQU 3
WIZ_SS__DR EQU CYREG_PRT0_DR
WIZ_SS__INTCFG EQU CYREG_PRT0_INTCFG
WIZ_SS__INTSTAT EQU CYREG_PRT0_INTSTAT
WIZ_SS__MASK EQU 0x08
WIZ_SS__PA__CFG0 EQU CYREG_UDB_PA0_CFG0
WIZ_SS__PA__CFG1 EQU CYREG_UDB_PA0_CFG1
WIZ_SS__PA__CFG10 EQU CYREG_UDB_PA0_CFG10
WIZ_SS__PA__CFG11 EQU CYREG_UDB_PA0_CFG11
WIZ_SS__PA__CFG12 EQU CYREG_UDB_PA0_CFG12
WIZ_SS__PA__CFG13 EQU CYREG_UDB_PA0_CFG13
WIZ_SS__PA__CFG14 EQU CYREG_UDB_PA0_CFG14
WIZ_SS__PA__CFG2 EQU CYREG_UDB_PA0_CFG2
WIZ_SS__PA__CFG3 EQU CYREG_UDB_PA0_CFG3
WIZ_SS__PA__CFG4 EQU CYREG_UDB_PA0_CFG4
WIZ_SS__PA__CFG5 EQU CYREG_UDB_PA0_CFG5
WIZ_SS__PA__CFG6 EQU CYREG_UDB_PA0_CFG6
WIZ_SS__PA__CFG7 EQU CYREG_UDB_PA0_CFG7
WIZ_SS__PA__CFG8 EQU CYREG_UDB_PA0_CFG8
WIZ_SS__PA__CFG9 EQU CYREG_UDB_PA0_CFG9
WIZ_SS__PC EQU CYREG_PRT0_PC
WIZ_SS__PC2 EQU CYREG_PRT0_PC2
WIZ_SS__PORT EQU 0
WIZ_SS__PS EQU CYREG_PRT0_PS
WIZ_SS__SHIFT EQU 3

/* Timer_1_cy_m0s8_tcpwm_1 */
Timer_1_cy_m0s8_tcpwm_1__CC EQU CYREG_TCPWM_CNT0_CC
Timer_1_cy_m0s8_tcpwm_1__CC_BUFF EQU CYREG_TCPWM_CNT0_CC_BUFF
Timer_1_cy_m0s8_tcpwm_1__COUNTER EQU CYREG_TCPWM_CNT0_COUNTER
Timer_1_cy_m0s8_tcpwm_1__CTRL EQU CYREG_TCPWM_CNT0_CTRL
Timer_1_cy_m0s8_tcpwm_1__INTR EQU CYREG_TCPWM_CNT0_INTR
Timer_1_cy_m0s8_tcpwm_1__INTR_MASK EQU CYREG_TCPWM_CNT0_INTR_MASK
Timer_1_cy_m0s8_tcpwm_1__INTR_MASKED EQU CYREG_TCPWM_CNT0_INTR_MASKED
Timer_1_cy_m0s8_tcpwm_1__INTR_SET EQU CYREG_TCPWM_CNT0_INTR_SET
Timer_1_cy_m0s8_tcpwm_1__PERIOD EQU CYREG_TCPWM_CNT0_PERIOD
Timer_1_cy_m0s8_tcpwm_1__PERIOD_BUFF EQU CYREG_TCPWM_CNT0_PERIOD_BUFF
Timer_1_cy_m0s8_tcpwm_1__STATUS EQU CYREG_TCPWM_CNT0_STATUS
Timer_1_cy_m0s8_tcpwm_1__TCPWM_CMD EQU CYREG_TCPWM_CMD
Timer_1_cy_m0s8_tcpwm_1__TCPWM_CMDCAPTURE_MASK EQU 0x01
Timer_1_cy_m0s8_tcpwm_1__TCPWM_CMDCAPTURE_SHIFT EQU 0
Timer_1_cy_m0s8_tcpwm_1__TCPWM_CMDRELOAD_MASK EQU 0x100
Timer_1_cy_m0s8_tcpwm_1__TCPWM_CMDRELOAD_SHIFT EQU 8
Timer_1_cy_m0s8_tcpwm_1__TCPWM_CMDSTART_MASK EQU 0x1000000
Timer_1_cy_m0s8_tcpwm_1__TCPWM_CMDSTART_SHIFT EQU 24
Timer_1_cy_m0s8_tcpwm_1__TCPWM_CMDSTOP_MASK EQU 0x10000
Timer_1_cy_m0s8_tcpwm_1__TCPWM_CMDSTOP_SHIFT EQU 16
Timer_1_cy_m0s8_tcpwm_1__TCPWM_CTRL EQU CYREG_TCPWM_CTRL
Timer_1_cy_m0s8_tcpwm_1__TCPWM_CTRL_MASK EQU 0x01
Timer_1_cy_m0s8_tcpwm_1__TCPWM_CTRL_SHIFT EQU 0
Timer_1_cy_m0s8_tcpwm_1__TCPWM_INTR_CAUSE EQU CYREG_TCPWM_INTR_CAUSE
Timer_1_cy_m0s8_tcpwm_1__TCPWM_INTR_CAUSE_MASK EQU 0x01
Timer_1_cy_m0s8_tcpwm_1__TCPWM_INTR_CAUSE_SHIFT EQU 0
Timer_1_cy_m0s8_tcpwm_1__TCPWM_NUMBER EQU 0
Timer_1_cy_m0s8_tcpwm_1__TR_CTRL0 EQU CYREG_TCPWM_CNT0_TR_CTRL0
Timer_1_cy_m0s8_tcpwm_1__TR_CTRL1 EQU CYREG_TCPWM_CNT0_TR_CTRL1
Timer_1_cy_m0s8_tcpwm_1__TR_CTRL2 EQU CYREG_TCPWM_CNT0_TR_CTRL2

/* WIZ_INT */
WIZ_INT__0__DM__MASK EQU 0x07
WIZ_INT__0__DM__SHIFT EQU 0
WIZ_INT__0__DR EQU CYREG_PRT0_DR
WIZ_INT__0__HSIOM EQU CYREG_HSIOM_PORT_SEL0
WIZ_INT__0__HSIOM_MASK EQU 0x0000000F
WIZ_INT__0__HSIOM_SHIFT EQU 0
WIZ_INT__0__INTCFG EQU CYREG_PRT0_INTCFG
WIZ_INT__0__INTSTAT EQU CYREG_PRT0_INTSTAT
WIZ_INT__0__MASK EQU 0x01
WIZ_INT__0__PA__CFG0 EQU CYREG_UDB_PA0_CFG0
WIZ_INT__0__PA__CFG1 EQU CYREG_UDB_PA0_CFG1
WIZ_INT__0__PA__CFG10 EQU CYREG_UDB_PA0_CFG10
WIZ_INT__0__PA__CFG11 EQU CYREG_UDB_PA0_CFG11
WIZ_INT__0__PA__CFG12 EQU CYREG_UDB_PA0_CFG12
WIZ_INT__0__PA__CFG13 EQU CYREG_UDB_PA0_CFG13
WIZ_INT__0__PA__CFG14 EQU CYREG_UDB_PA0_CFG14
WIZ_INT__0__PA__CFG2 EQU CYREG_UDB_PA0_CFG2
WIZ_INT__0__PA__CFG3 EQU CYREG_UDB_PA0_CFG3
WIZ_INT__0__PA__CFG4 EQU CYREG_UDB_PA0_CFG4
WIZ_INT__0__PA__CFG5 EQU CYREG_UDB_PA0_CFG5
WIZ_INT__0__PA__CFG6 EQU CYREG_UDB_PA0_CFG6
WIZ_INT__0__PA__CFG7 EQU CYREG_UDB_PA0_CFG7
WIZ_INT__0__PA__CFG8 EQU CYREG_UDB_PA0_CFG8
WIZ_INT__0__PA__CFG9 EQU CYREG_UDB_PA0_CFG9
WIZ_INT__0__PC EQU CYREG_PRT0_PC
WIZ_INT__0__PC2 EQU CYREG_PRT0_PC2
WIZ_INT__0__PORT EQU 0
WIZ_INT__0__PS EQU CYREG_PRT0_PS
WIZ_INT__0__SHIFT EQU 0
WIZ_INT__DR EQU CYREG_PRT0_DR
WIZ_INT__INTCFG EQU CYREG_PRT0_INTCFG
WIZ_INT__INTSTAT EQU CYREG_PRT0_INTSTAT
WIZ_INT__MASK EQU 0x01
WIZ_INT__PA__CFG0 EQU CYREG_UDB_PA0_CFG0
WIZ_INT__PA__CFG1 EQU CYREG_UDB_PA0_CFG1
WIZ_INT__PA__CFG10 EQU CYREG_UDB_PA0_CFG10
WIZ_INT__PA__CFG11 EQU CYREG_UDB_PA0_CFG11
WIZ_INT__PA__CFG12 EQU CYREG_UDB_PA0_CFG12
WIZ_INT__PA__CFG13 EQU CYREG_UDB_PA0_CFG13
WIZ_INT__PA__CFG14 EQU CYREG_UDB_PA0_CFG14
WIZ_INT__PA__CFG2 EQU CYREG_UDB_PA0_CFG2
WIZ_INT__PA__CFG3 EQU CYREG_UDB_PA0_CFG3
WIZ_INT__PA__CFG4 EQU CYREG_UDB_PA0_CFG4
WIZ_INT__PA__CFG5 EQU CYREG_UDB_PA0_CFG5
WIZ_INT__PA__CFG6 EQU CYREG_UDB_PA0_CFG6
WIZ_INT__PA__CFG7 EQU CYREG_UDB_PA0_CFG7
WIZ_INT__PA__CFG8 EQU CYREG_UDB_PA0_CFG8
WIZ_INT__PA__CFG9 EQU CYREG_UDB_PA0_CFG9
WIZ_INT__PC EQU CYREG_PRT0_PC
WIZ_INT__PC2 EQU CYREG_PRT0_PC2
WIZ_INT__PORT EQU 0
WIZ_INT__PS EQU CYREG_PRT0_PS
WIZ_INT__SHIFT EQU 0

/* WIZ_RDY */
WIZ_RDY__0__DM__MASK EQU 0x38
WIZ_RDY__0__DM__SHIFT EQU 3
WIZ_RDY__0__DR EQU CYREG_PRT0_DR
WIZ_RDY__0__HSIOM EQU CYREG_HSIOM_PORT_SEL0
WIZ_RDY__0__HSIOM_MASK EQU 0x000000F0
WIZ_RDY__0__HSIOM_SHIFT EQU 4
WIZ_RDY__0__INTCFG EQU CYREG_PRT0_INTCFG
WIZ_RDY__0__INTSTAT EQU CYREG_PRT0_INTSTAT
WIZ_RDY__0__MASK EQU 0x02
WIZ_RDY__0__PA__CFG0 EQU CYREG_UDB_PA0_CFG0
WIZ_RDY__0__PA__CFG1 EQU CYREG_UDB_PA0_CFG1
WIZ_RDY__0__PA__CFG10 EQU CYREG_UDB_PA0_CFG10
WIZ_RDY__0__PA__CFG11 EQU CYREG_UDB_PA0_CFG11
WIZ_RDY__0__PA__CFG12 EQU CYREG_UDB_PA0_CFG12
WIZ_RDY__0__PA__CFG13 EQU CYREG_UDB_PA0_CFG13
WIZ_RDY__0__PA__CFG14 EQU CYREG_UDB_PA0_CFG14
WIZ_RDY__0__PA__CFG2 EQU CYREG_UDB_PA0_CFG2
WIZ_RDY__0__PA__CFG3 EQU CYREG_UDB_PA0_CFG3
WIZ_RDY__0__PA__CFG4 EQU CYREG_UDB_PA0_CFG4
WIZ_RDY__0__PA__CFG5 EQU CYREG_UDB_PA0_CFG5
WIZ_RDY__0__PA__CFG6 EQU CYREG_UDB_PA0_CFG6
WIZ_RDY__0__PA__CFG7 EQU CYREG_UDB_PA0_CFG7
WIZ_RDY__0__PA__CFG8 EQU CYREG_UDB_PA0_CFG8
WIZ_RDY__0__PA__CFG9 EQU CYREG_UDB_PA0_CFG9
WIZ_RDY__0__PC EQU CYREG_PRT0_PC
WIZ_RDY__0__PC2 EQU CYREG_PRT0_PC2
WIZ_RDY__0__PORT EQU 0
WIZ_RDY__0__PS EQU CYREG_PRT0_PS
WIZ_RDY__0__SHIFT EQU 1
WIZ_RDY__DR EQU CYREG_PRT0_DR
WIZ_RDY__INTCFG EQU CYREG_PRT0_INTCFG
WIZ_RDY__INTSTAT EQU CYREG_PRT0_INTSTAT
WIZ_RDY__MASK EQU 0x02
WIZ_RDY__PA__CFG0 EQU CYREG_UDB_PA0_CFG0
WIZ_RDY__PA__CFG1 EQU CYREG_UDB_PA0_CFG1
WIZ_RDY__PA__CFG10 EQU CYREG_UDB_PA0_CFG10
WIZ_RDY__PA__CFG11 EQU CYREG_UDB_PA0_CFG11
WIZ_RDY__PA__CFG12 EQU CYREG_UDB_PA0_CFG12
WIZ_RDY__PA__CFG13 EQU CYREG_UDB_PA0_CFG13
WIZ_RDY__PA__CFG14 EQU CYREG_UDB_PA0_CFG14
WIZ_RDY__PA__CFG2 EQU CYREG_UDB_PA0_CFG2
WIZ_RDY__PA__CFG3 EQU CYREG_UDB_PA0_CFG3
WIZ_RDY__PA__CFG4 EQU CYREG_UDB_PA0_CFG4
WIZ_RDY__PA__CFG5 EQU CYREG_UDB_PA0_CFG5
WIZ_RDY__PA__CFG6 EQU CYREG_UDB_PA0_CFG6
WIZ_RDY__PA__CFG7 EQU CYREG_UDB_PA0_CFG7
WIZ_RDY__PA__CFG8 EQU CYREG_UDB_PA0_CFG8
WIZ_RDY__PA__CFG9 EQU CYREG_UDB_PA0_CFG9
WIZ_RDY__PC EQU CYREG_PRT0_PC
WIZ_RDY__PC2 EQU CYREG_PRT0_PC2
WIZ_RDY__PORT EQU 0
WIZ_RDY__PS EQU CYREG_PRT0_PS
WIZ_RDY__SHIFT EQU 1

/* WIZ_RST */
WIZ_RST__0__DM__MASK EQU 0x1C0
WIZ_RST__0__DM__SHIFT EQU 6
WIZ_RST__0__DR EQU CYREG_PRT0_DR
WIZ_RST__0__HSIOM EQU CYREG_HSIOM_PORT_SEL0
WIZ_RST__0__HSIOM_MASK EQU 0x00000F00
WIZ_RST__0__HSIOM_SHIFT EQU 8
WIZ_RST__0__INTCFG EQU CYREG_PRT0_INTCFG
WIZ_RST__0__INTSTAT EQU CYREG_PRT0_INTSTAT
WIZ_RST__0__MASK EQU 0x04
WIZ_RST__0__PA__CFG0 EQU CYREG_UDB_PA0_CFG0
WIZ_RST__0__PA__CFG1 EQU CYREG_UDB_PA0_CFG1
WIZ_RST__0__PA__CFG10 EQU CYREG_UDB_PA0_CFG10
WIZ_RST__0__PA__CFG11 EQU CYREG_UDB_PA0_CFG11
WIZ_RST__0__PA__CFG12 EQU CYREG_UDB_PA0_CFG12
WIZ_RST__0__PA__CFG13 EQU CYREG_UDB_PA0_CFG13
WIZ_RST__0__PA__CFG14 EQU CYREG_UDB_PA0_CFG14
WIZ_RST__0__PA__CFG2 EQU CYREG_UDB_PA0_CFG2
WIZ_RST__0__PA__CFG3 EQU CYREG_UDB_PA0_CFG3
WIZ_RST__0__PA__CFG4 EQU CYREG_UDB_PA0_CFG4
WIZ_RST__0__PA__CFG5 EQU CYREG_UDB_PA0_CFG5
WIZ_RST__0__PA__CFG6 EQU CYREG_UDB_PA0_CFG6
WIZ_RST__0__PA__CFG7 EQU CYREG_UDB_PA0_CFG7
WIZ_RST__0__PA__CFG8 EQU CYREG_UDB_PA0_CFG8
WIZ_RST__0__PA__CFG9 EQU CYREG_UDB_PA0_CFG9
WIZ_RST__0__PC EQU CYREG_PRT0_PC
WIZ_RST__0__PC2 EQU CYREG_PRT0_PC2
WIZ_RST__0__PORT EQU 0
WIZ_RST__0__PS EQU CYREG_PRT0_PS
WIZ_RST__0__SHIFT EQU 2
WIZ_RST__DR EQU CYREG_PRT0_DR
WIZ_RST__INTCFG EQU CYREG_PRT0_INTCFG
WIZ_RST__INTSTAT EQU CYREG_PRT0_INTSTAT
WIZ_RST__MASK EQU 0x04
WIZ_RST__PA__CFG0 EQU CYREG_UDB_PA0_CFG0
WIZ_RST__PA__CFG1 EQU CYREG_UDB_PA0_CFG1
WIZ_RST__PA__CFG10 EQU CYREG_UDB_PA0_CFG10
WIZ_RST__PA__CFG11 EQU CYREG_UDB_PA0_CFG11
WIZ_RST__PA__CFG12 EQU CYREG_UDB_PA0_CFG12
WIZ_RST__PA__CFG13 EQU CYREG_UDB_PA0_CFG13
WIZ_RST__PA__CFG14 EQU CYREG_UDB_PA0_CFG14
WIZ_RST__PA__CFG2 EQU CYREG_UDB_PA0_CFG2
WIZ_RST__PA__CFG3 EQU CYREG_UDB_PA0_CFG3
WIZ_RST__PA__CFG4 EQU CYREG_UDB_PA0_CFG4
WIZ_RST__PA__CFG5 EQU CYREG_UDB_PA0_CFG5
WIZ_RST__PA__CFG6 EQU CYREG_UDB_PA0_CFG6
WIZ_RST__PA__CFG7 EQU CYREG_UDB_PA0_CFG7
WIZ_RST__PA__CFG8 EQU CYREG_UDB_PA0_CFG8
WIZ_RST__PA__CFG9 EQU CYREG_UDB_PA0_CFG9
WIZ_RST__PC EQU CYREG_PRT0_PC
WIZ_RST__PC2 EQU CYREG_PRT0_PC2
WIZ_RST__PORT EQU 0
WIZ_RST__PS EQU CYREG_PRT0_PS
WIZ_RST__SHIFT EQU 2

/* Clock_pwm */
Clock_pwm__DIVIDER_MASK EQU 0x0000FFFF
Clock_pwm__ENABLE EQU CYREG_CLK_DIVIDER_C00
Clock_pwm__ENABLE_MASK EQU 0x80000000
Clock_pwm__MASK EQU 0x80000000
Clock_pwm__REGISTER EQU CYREG_CLK_DIVIDER_C00

/* Clock_counter */
Clock_counter__DIVIDER_MASK EQU 0x0000FFFF
Clock_counter__ENABLE EQU CYREG_CLK_DIVIDER_B00
Clock_counter__ENABLE_MASK EQU 0x80000000
Clock_counter__MASK EQU 0x80000000
Clock_counter__REGISTER EQU CYREG_CLK_DIVIDER_B00

/* Miscellaneous */
CYDEV_BCLK__HFCLK__HZ EQU 24000000
CYDEV_BCLK__HFCLK__KHZ EQU 24000
CYDEV_BCLK__HFCLK__MHZ EQU 24
CYDEV_BCLK__SYSCLK__HZ EQU 24000000
CYDEV_BCLK__SYSCLK__KHZ EQU 24000
CYDEV_BCLK__SYSCLK__MHZ EQU 24
CYDEV_CHIP_DIE_LEOPARD EQU 1
CYDEV_CHIP_DIE_PANTHER EQU 6
CYDEV_CHIP_DIE_PSOC4A EQU 3
CYDEV_CHIP_DIE_PSOC5LP EQU 5
CYDEV_CHIP_DIE_UNKNOWN EQU 0
CYDEV_CHIP_FAMILY_PSOC3 EQU 1
CYDEV_CHIP_FAMILY_PSOC4 EQU 2
CYDEV_CHIP_FAMILY_PSOC5 EQU 3
CYDEV_CHIP_FAMILY_UNKNOWN EQU 0
CYDEV_CHIP_FAMILY_USED EQU CYDEV_CHIP_FAMILY_PSOC4
CYDEV_CHIP_JTAG_ID EQU 0x04C81193
CYDEV_CHIP_MEMBER_3A EQU 1
CYDEV_CHIP_MEMBER_4A EQU 3
CYDEV_CHIP_MEMBER_4D EQU 2
CYDEV_CHIP_MEMBER_4F EQU 4
CYDEV_CHIP_MEMBER_5A EQU 6
CYDEV_CHIP_MEMBER_5B EQU 5
CYDEV_CHIP_MEMBER_UNKNOWN EQU 0
CYDEV_CHIP_MEMBER_USED EQU CYDEV_CHIP_MEMBER_4A
CYDEV_CHIP_DIE_EXPECT EQU CYDEV_CHIP_MEMBER_USED
CYDEV_CHIP_DIE_ACTUAL EQU CYDEV_CHIP_DIE_EXPECT
CYDEV_CHIP_REV_LEOPARD_ES1 EQU 0
CYDEV_CHIP_REV_LEOPARD_ES2 EQU 1
CYDEV_CHIP_REV_LEOPARD_ES3 EQU 3
CYDEV_CHIP_REV_LEOPARD_PRODUCTION EQU 3
CYDEV_CHIP_REV_PANTHER_ES0 EQU 0
CYDEV_CHIP_REV_PANTHER_ES1 EQU 1
CYDEV_CHIP_REV_PANTHER_PRODUCTION EQU 1
CYDEV_CHIP_REV_PSOC4A_ES0 EQU 17
CYDEV_CHIP_REV_PSOC4A_PRODUCTION EQU 17
CYDEV_CHIP_REV_PSOC5LP_ES0 EQU 0
CYDEV_CHIP_REV_PSOC5LP_PRODUCTION EQU 0
CYDEV_CHIP_REVISION_3A_ES1 EQU 0
CYDEV_CHIP_REVISION_3A_ES2 EQU 1
CYDEV_CHIP_REVISION_3A_ES3 EQU 3
CYDEV_CHIP_REVISION_3A_PRODUCTION EQU 3
CYDEV_CHIP_REVISION_4A_ES0 EQU 17
CYDEV_CHIP_REVISION_4A_PRODUCTION EQU 17
CYDEV_CHIP_REVISION_4D_PRODUCTION EQU 0
CYDEV_CHIP_REVISION_4F_PRODUCTION EQU 0
CYDEV_CHIP_REVISION_5A_ES0 EQU 0
CYDEV_CHIP_REVISION_5A_ES1 EQU 1
CYDEV_CHIP_REVISION_5A_PRODUCTION EQU 1
CYDEV_CHIP_REVISION_5B_ES0 EQU 0
CYDEV_CHIP_REVISION_5B_PRODUCTION EQU 0
CYDEV_CHIP_REVISION_USED EQU CYDEV_CHIP_REVISION_4A_PRODUCTION
CYDEV_CHIP_REV_EXPECT EQU CYDEV_CHIP_REVISION_USED
CYDEV_CONFIG_READ_ACCELERATOR EQU 1
CYDEV_CONFIG_UNUSED_IO_AllowButWarn EQU 0
CYDEV_CONFIG_UNUSED_IO EQU CYDEV_CONFIG_UNUSED_IO_AllowButWarn
CYDEV_CONFIG_UNUSED_IO_AllowWithInfo EQU 1
CYDEV_CONFIG_UNUSED_IO_Disallowed EQU 2
CYDEV_CONFIGURATION_COMPRESSED EQU 1
CYDEV_CONFIGURATION_MODE_COMPRESSED EQU 0
CYDEV_CONFIGURATION_MODE EQU CYDEV_CONFIGURATION_MODE_COMPRESSED
CYDEV_CONFIGURATION_MODE_DMA EQU 2
CYDEV_CONFIGURATION_MODE_UNCOMPRESSED EQU 1
CYDEV_DEBUG_PROTECT_KILL EQU 4
CYDEV_DEBUG_PROTECT_OPEN EQU 1
CYDEV_DEBUG_PROTECT EQU CYDEV_DEBUG_PROTECT_OPEN
CYDEV_DEBUG_PROTECT_PROTECTED EQU 2
CYDEV_DEBUGGING_DPS_Disable EQU 3
CYDEV_DEBUGGING_DPS_SWD EQU 2
CYDEV_DEBUGGING_DPS EQU CYDEV_DEBUGGING_DPS_SWD
CYDEV_DEBUGGING_ENABLE EQU 1
CYDEV_HEAP_SIZE EQU 0x80
CYDEV_PROJ_TYPE EQU 2
CYDEV_PROJ_TYPE_BOOTLOADER EQU 1
CYDEV_PROJ_TYPE_LOADABLE EQU 2
CYDEV_PROJ_TYPE_MULTIAPPBOOTLOADER EQU 3
CYDEV_PROJ_TYPE_STANDARD EQU 0
CYDEV_STACK_SIZE EQU 0x0400
CYDEV_USE_BUNDLED_CMSIS EQU 1
CYDEV_VARIABLE_VDDA EQU 1
CYDEV_VDDA_MV EQU 3300
CYDEV_VDDD_MV EQU 3300
CYIPBLOCK_M0S8_CTBM_VERSION EQU 0
CYIPBLOCK_m0s8cpuss_VERSION EQU 0
CYIPBLOCK_m0s8csd_VERSION EQU 0
CYIPBLOCK_m0s8gpio2_VERSION EQU 0
CYIPBLOCK_m0s8hsiom4a_VERSION EQU 0
CYIPBLOCK_m0s8lcd_VERSION EQU 0
CYIPBLOCK_m0s8lpcomp_VERSION EQU 0
CYIPBLOCK_m0s8pclk_VERSION EQU 0
CYIPBLOCK_m0s8sar_VERSION EQU 0
CYIPBLOCK_m0s8scb_VERSION EQU 0
CYIPBLOCK_m0s8srssv2_VERSION EQU 1
CYIPBLOCK_m0s8tcpwm_VERSION EQU 0
CYIPBLOCK_m0s8udbif_VERSION EQU 0
CYIPBLOCK_S8_GPIO_VERSION EQU 2
CYDEV_BOOTLOADER_ENABLE EQU 0

#endif /* INCLUDED_CYFITTERIAR_INC */
