# CY8C4247LQI_BL483 register map
File version: 0.1
PSoC 4200 BLE
Registers are 32-bit, read-write, no defined reset value unless marked. A register's access mark holds for its fields unless they carry their own. Offsets are from the block's base; lines under a group give offsets from that group; [hi:lo] are bit positions; {n}, {i} and the like mark numbered series; 'fields as' and 'values as' point back to an identical list; <NAME> marks a mode.

## Memory map
0x00000000 Timer_1

## Timer_1
Base 0x00000000
0x40200108 COUNTER — Current counter value
0x4020010C CC — Compare / capture value
0x40200110 CC_BUF — Compare / capture buffer value
0x40200114 PERIOD — Period value
0x40200118 PERIOD_BUF — Period buffer value
