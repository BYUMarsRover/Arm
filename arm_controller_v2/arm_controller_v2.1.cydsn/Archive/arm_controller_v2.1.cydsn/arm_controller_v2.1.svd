# CY8C4245AXI_483 register map
File version: 0.1
PSoC 4200
Registers are 32-bit, read-write, no defined reset value unless marked. A register's access mark holds for its fields unless they carry their own. Offsets are from the block's base; lines under a group give offsets from that group; [hi:lo] are bit positions; {n}, {i} and the like mark numbered series; 'fields as' and 'values as' point back to an identical list; <NAME> marks a mode.

## Memory map
0x00000000 PWM_3
0x00000000 PWM_1
0x00000000 PWM_2
0x00000000 Timer_1

## PWM_3
Base 0x00000000
0x40050108 COUNTER — Current counter value
0x4005010C CC — Compare / capture value
0x40050110 CC_BUF — Compare / capture buffer value
0x40050114 PERIOD — Period value
0x40050118 PERIOD_BUF — Period buffer value

## PWM_1
Base 0x00000000
0x40050188 COUNTER — Current counter value
0x4005018C CC — Compare / capture value
0x40050190 CC_BUF — Compare / capture buffer value
0x40050194 PERIOD — Period value
0x40050198 PERIOD_BUF — Period buffer value

## PWM_2
Base 0x00000000
0x40050148 COUNTER — Current counter value
0x4005014C CC — Compare / capture value
0x40050150 CC_BUF — Compare / capture buffer value
0x40050154 PERIOD — Period value
0x40050158 PERIOD_BUF — Period buffer value

## Timer_1
Base 0x00000000
0x400501C8 COUNTER — Current counter value
0x400501CC CC — Compare / capture value
0x400501D0 CC_BUF — Compare / capture buffer value
0x400501D4 PERIOD — Period value
0x400501D8 PERIOD_BUF — Period buffer value
